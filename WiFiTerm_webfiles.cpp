//Generated by webfiles.py

#include "WiFiTerm_webfiles.h"

WiFiTerm_webfiles_c WiFiTerm_webfiles;

WiFiTerm_webfiles_c::WiFiTerm_webfiles_c()
{
  server = NULL;
}

const char webfiles_favicon_ico_path_P[] PROGMEM = "/favicon.ico";
const char webfiles_term_html_path_P[] PROGMEM = "/term.html";
const char webfiles_icons_greenArrow_png_path_P[] PROGMEM = "/icons/greenArrow.png";
const char webfiles_icons_redArrow_png_path_P[] PROGMEM = "/icons/redArrow.png";
const char webfiles_scripts_term_js_path_P[] PROGMEM = "/scripts/term.js";
const char webfiles_styles_term_css_path_P[] PROGMEM = "/styles/term.css";

const char WiFiTerm_webfiles_content_type_ico_P[] PROGMEM = "image/vnd.microsoft.icon";
const char WiFiTerm_webfiles_content_type_html_P[] PROGMEM = "text/html";
const char WiFiTerm_webfiles_content_type_png_P[] PROGMEM = "image/png";
const char WiFiTerm_webfiles_content_type_js_P[] PROGMEM = "application/javascript";
const char WiFiTerm_webfiles_content_type_css_P[] PROGMEM = "text/css";

void WiFiTerm_webfiles_c::begin(WebServer &webServer)
{
  server = &webServer;

  char path[22];

  strcpy_P(path, webfiles_term_html_path_P);
  server->on(path, send_webfiles_term_html);

  strcpy_P(path, webfiles_icons_greenArrow_png_path_P);
  server->on(path, send_webfiles_icons_greenArrow_png);

  strcpy_P(path, webfiles_icons_redArrow_png_path_P);
  server->on(path, send_webfiles_icons_redArrow_png);

  strcpy_P(path, webfiles_scripts_term_js_path_P);
  server->on(path, send_webfiles_scripts_term_js);

  strcpy_P(path, webfiles_styles_term_css_path_P);
  server->on(path, send_webfiles_styles_term_css);
}

void WiFiTerm_webfiles_c::activateFavicon()
{
  char path[22];
  if (server != NULL)
  {
    strcpy_P(path, webfiles_favicon_ico_path_P);
    server->on(path, send_webfiles_favicon_ico);
  }
}

const char webfiles_favicon_ico_P[] PROGMEM =
{
  0x89, 0x50, 0x4e, 0x47, 0x0d, 0x0a, 0x1a, 0x0a, 0x00, 0x00, 0x00, 0x0d,
  0x49, 0x48, 0x44, 0x52, 0x00, 0x00, 0x00, 0x30, 0x00, 0x00, 0x00, 0x30,
  0x08, 0x06, 0x00, 0x00, 0x00, 0x57, 0x02, 0xf9, 0x87, 0x00, 0x00, 0x0b,
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  0x60, 0x82
};

void WiFiTerm_webfiles_c::send_webfiles_favicon_ico()
{
  if (WiFiTerm_webfiles.server != NULL)
  {
    WiFiTerm_webfiles.server->send_P(
      200,
      WiFiTerm_webfiles_content_type_ico_P,
      webfiles_favicon_ico_P,
      2954
    );
  }
}

const char webfiles_term_html_P[] PROGMEM =
{
  0x3c, 0x21, 0x44, 0x4f, 0x43, 0x54, 0x59, 0x50, 0x45, 0x20, 0x68, 0x74,
  0x6d, 0x6c, 0x3e, 0x0a, 0x3c, 0x68, 0x74, 0x6d, 0x6c, 0x3e, 0x0a, 0x20,
  0x20, 0x20, 0x20, 0x3c, 0x68, 0x65, 0x61, 0x64, 0x3e, 0x0a, 0x20, 0x20,
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  0x0a, 0x3c, 0x2f, 0x68, 0x74, 0x6d, 0x6c, 0x3e
};

void WiFiTerm_webfiles_c::send_webfiles_term_html()
{
  if (WiFiTerm_webfiles.server != NULL)
  {
    WiFiTerm_webfiles.server->send_P(
      200,
      WiFiTerm_webfiles_content_type_html_P,
      webfiles_term_html_P,
      1160
    );
  }
}

const char webfiles_icons_greenArrow_png_P[] PROGMEM =
{
  0x89, 0x50, 0x4e, 0x47, 0x0d, 0x0a, 0x1a, 0x0a, 0x00, 0x00, 0x00, 0x0d,
  0x49, 0x48, 0x44, 0x52, 0x00, 0x00, 0x00, 0x17, 0x00, 0x00, 0x00, 0x11,
  0x08, 0x02, 0x00, 0x00, 0x00, 0xb9, 0x11, 0xa0, 0xea, 0x00, 0x00, 0x00,
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  0x44, 0xae, 0x42, 0x60, 0x82
};

void WiFiTerm_webfiles_c::send_webfiles_icons_greenArrow_png()
{
  if (WiFiTerm_webfiles.server != NULL)
  {
    WiFiTerm_webfiles.server->send_P(
      200,
      WiFiTerm_webfiles_content_type_png_P,
      webfiles_icons_greenArrow_png_P,
      413
    );
  }
}

const char webfiles_icons_redArrow_png_P[] PROGMEM =
{
  0x89, 0x50, 0x4e, 0x47, 0x0d, 0x0a, 0x1a, 0x0a, 0x00, 0x00, 0x00, 0x0d,
  0x49, 0x48, 0x44, 0x52, 0x00, 0x00, 0x00, 0x17, 0x00, 0x00, 0x00, 0x11,
  0x08, 0x02, 0x00, 0x00, 0x00, 0xb9, 0x11, 0xa0, 0xea, 0x00, 0x00, 0x00,
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  0x00, 0x00, 0x49, 0x45, 0x4e, 0x44, 0xae, 0x42, 0x60, 0x82
};

void WiFiTerm_webfiles_c::send_webfiles_icons_redArrow_png()
{
  if (WiFiTerm_webfiles.server != NULL)
  {
    WiFiTerm_webfiles.server->send_P(
      200,
      WiFiTerm_webfiles_content_type_png_P,
      webfiles_icons_redArrow_png_P,
      406
    );
  }
}

const char webfiles_scripts_term_js_P[] PROGMEM =
{
  0x76, 0x61, 0x72, 0x20, 0x77, 0x73, 0x3b, 0x0d, 0x0a, 0x76, 0x61, 0x72,
  0x20, 0x45, 0x53, 0x50, 0x5f, 0x69, 0x70, 0x3b, 0x0d, 0x0a, 0x6c, 0x65,
  0x74, 0x20, 0x63, 0x6f, 0x6e, 0x6e, 0x65, 0x63, 0x74, 0x65, 0x64, 0x20,
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  0x29, 0x3b, 0x0d, 0x0a
};

void WiFiTerm_webfiles_c::send_webfiles_scripts_term_js()
{
  if (WiFiTerm_webfiles.server != NULL)
  {
    WiFiTerm_webfiles.server->send_P(
      200,
      WiFiTerm_webfiles_content_type_js_P,
      webfiles_scripts_term_js_P,
      3508
    );
  }
}

const char webfiles_styles_term_css_P[] PROGMEM =
{
  0x68, 0x74, 0x6d, 0x6c, 0x2c, 0x62, 0x6f, 0x64, 0x79, 0x2c, 0x23, 0x74,
  0x65, 0x72, 0x6d, 0x69, 0x6e, 0x61, 0x6c, 0x7b, 0x68, 0x65, 0x69, 0x67,
  0x68, 0x74, 0x3a, 0x31, 0x30, 0x30, 0x25, 0x3b, 0x77, 0x69, 0x64, 0x74,
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  0x0d, 0x0a, 0x7d, 0x0d, 0x0a
};

void WiFiTerm_webfiles_c::send_webfiles_styles_term_css()
{
  if (WiFiTerm_webfiles.server != NULL)
  {
    WiFiTerm_webfiles.server->send_P(
      200,
      WiFiTerm_webfiles_content_type_css_P,
      webfiles_styles_term_css_P,
      1169
    );
  }
}

